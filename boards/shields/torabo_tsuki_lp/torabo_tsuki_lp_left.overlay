#include "torabo_tsuki_lp.dtsi"
#include <input/processors.dtsi>
#include <dt-bindings/zmk/input_transform.h>

&trackball_listener {
    input-processors =
        <&zip_xy_transform (INPUT_TRANSFORM_X_INVERT | INPUT_TRANSFORM_Y_INVERT)>;

    scroller {
        layers = <3>;
        input-processors =
            <&zip_xy_to_scroll_mapper>,
            <&zip_scroll_transform>,
            <&zip_scroll_scaler 1 8>;
    };
};
